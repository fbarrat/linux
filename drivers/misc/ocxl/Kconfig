## drivers/misc/ocxl/Kconfig
```kconfig
#
# Open Coherent Accelerator (OCXL) compatible devices
#

config OCXL_BASE
	bool
	default n
	select PPC_COPRO_BASE

config OCXL
	tristate "Support for Open Coherent Accelerators (OCXL)"
	depends on PPC_POWERNV && PCI && EEH
	select OCXL_BASE
	default m
	help

	  Select this option to enable driver support for Open
	  Coherent Accelerators (OCXL).  OCXL is otherwise known as
	  Open Coherent Accelerator Processor Interface (OCAPI).
	  OCAPI allows accelerators in FPGAs to be coherently attached
	  to a CPU through a Open CAPI link.  This driver enables
	  userspace programs to access these accelerators through
	  devices found in /dev/ocxl/

	  If unsure, say N.
```

## drivers/platform/Kconfig
```kconfig
if X86
source "drivers/platform/x86/Kconfig"
endif
if MIPS
source "drivers/platform/mips/Kconfig"
endif
if PPC64
source "drivers/platform/ppc64/Kconfig"
endif

source "drivers/platform/goldfish/Kconfig"

source "drivers/platform/chrome/Kconfig"
```

## drivers/platform/ppc64/Kconfig
```kconfig
#
# PPC64 Platform Specific Drivers
#

menuconfig PPC64_PLATFORM_DEVICES
	bool "Platform Specific Device Drivers for PPC64"
	default y
	help
	  Say Y here to get to see options for device drivers of various
	  ppc64 platforms. This option itself does not add any
	  kernel code.

	  If you say N, all options in this submenu will be skipped and disabled.

if PPC64_PLATFORM_DEVICES

config PPC_USRIRQ
	tristate "User IRQ Driver"
	depends on PPC_XIVE_NATIVE
	default m
	help
	  Driver to map IRQ to user space

endif # PPC64_PLATFORM_DEVICES
```
